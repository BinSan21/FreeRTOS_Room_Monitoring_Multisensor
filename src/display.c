#include "display.h"
#include "stm32f1xx_hal.h"
#include <stdio.h>
#include <string.h>

#define SSD1306_I2C_ADDR 0x78 /* 0x3C << 1 */
#define SSD1306_WIDTH    128
#define SSD1306_HEIGHT   64

#define I2C_SCL_PIN GPIO_PIN_6
#define I2C_SDA_PIN GPIO_PIN_7
#define I2C_PORT    GPIOB

static uint8_t ssd1306_buffer[SSD1306_WIDTH * SSD1306_HEIGHT / 8];

/* Compact 5x7 ASCII font for printable characters (0x20 to 0x7A) */
static const uint8_t font5x7[][5] = {
    {0x00,0x00,0x00,0x00,0x00}, /* ' ' 0x20 */
    {0x00,0x00,0x5F,0x00,0x00}, /* '!' */
    {0x00,0x07,0x00,0x07,0x00}, /* '"' */
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    {0x44,0x64,0x54,0x4C,0x44}  /* 'z' 0x7A */
};

static void i2c_delay(void) {
    for (volatile int i = 0; i < 15; i++) {
        __NOP();
    }
}

/* Drive PB6 (SCL) and PB7 (SDA) using register CRL for true open-drain + pull-up */
static inline void scl_high(void) {
    /* PB6 = Input with pull-up (CNF=10, MODE=00 -> 0x8) + ODR6=1 */
    GPIOB->BSRR = GPIO_PIN_6;
    GPIOB->CRL = (GPIOB->CRL & ~(0xFU << 24)) | (0x8U << 24);
}

static inline void scl_low(void) {
    /* PB6 = Output Push-Pull/OD LOW (CNF=00, MODE=11 -> 0x3) + BRR6=1 */
    GPIOB->BSRR = (uint32_t)GPIO_PIN_6 << 16U;
    GPIOB->CRL = (GPIOB->CRL & ~(0xFU << 24)) | (0x3U << 24);
}

static inline void sda_high(void) {
    /* PB7 = Input with pull-up (CNF=10, MODE=00 -> 0x8) + ODR7=1 */
    GPIOB->BSRR = GPIO_PIN_7;
    GPIOB->CRL = (GPIOB->CRL & ~(0xFU << 28)) | (0x8U << 28);
}

static inline void sda_low(void) {
    /* PB7 = Output LOW (CNF=00, MODE=11 -> 0x3) + BRR7=1 */
    GPIOB->BSRR = (uint32_t)GPIO_PIN_7 << 16U;
    GPIOB->CRL = (GPIOB->CRL & ~(0xFU << 28)) | (0x3U << 28);
}

static void i2c_start(void) {
    sda_high();
    scl_high();
    i2c_delay();
    sda_low();
    i2c_delay();
    scl_low();
    i2c_delay();
}

static void i2c_stop(void) {
    sda_low();
    i2c_delay();
    scl_high();
    i2c_delay();
    sda_high();
    i2c_delay();
}

static bool i2c_write_byte(uint8_t byte) {
    for (int i = 0; i < 8; i++) {
        if (byte & 0x80) {
            sda_high();
        } else {
            sda_low();
        }
        byte <<= 1;
        i2c_delay();
        scl_high();
        i2c_delay();
        scl_low();
    }
    /* Release SDA for ACK */
    sda_high();
    i2c_delay();
    scl_high();
    i2c_delay();
    bool ack = ((GPIOB->IDR & GPIO_PIN_7) == 0);
    scl_low();
    return ack;
}

static void ssd1306_write_cmd(uint8_t cmd) {
    i2c_start();
    i2c_write_byte(SSD1306_I2C_ADDR);
    i2c_write_byte(0x00);
    i2c_write_byte(cmd);
    i2c_stop();
}

static void ssd1306_update_screen(void) {
    for (uint8_t page = 0; page < 8; page++) {
        ssd1306_write_cmd(0xB0 + page);
        ssd1306_write_cmd(0x00);
        ssd1306_write_cmd(0x10);

        i2c_start();
        i2c_write_byte(SSD1306_I2C_ADDR);
        i2c_write_byte(0x40);
        for (uint16_t col = 0; col < SSD1306_WIDTH; col++) {
            i2c_write_byte(ssd1306_buffer[SSD1306_WIDTH * page + col]);
        }
        i2c_stop();
    }
}

static void ssd1306_draw_string(uint8_t page, uint8_t col, const char *str) {
    if (page >= 8) return;
    while (*str && (col + 6) <= SSD1306_WIDTH) {
        char c = *str++;
        if (c < 0x20 || c > 0x7A) c = ' ';
        const uint8_t *glyph = font5x7[c - 0x20];
        for (int i = 0; i < 5; i++) {
            ssd1306_buffer[page * SSD1306_WIDTH + col + i] = glyph[i];
        }
        ssd1306_buffer[page * SSD1306_WIDTH + col + 5] = 0x00;
        col += 6;
    }
}

void Display_Init(void) {
    __HAL_RCC_GPIOB_CLK_ENABLE();
    scl_high();
    sda_high();

    i2c_start();
    bool ack = i2c_write_byte(SSD1306_I2C_ADDR);
    i2c_stop();
    printf("[Display_Init] SSD1306 I2C ACK: %s\r\n", ack ? "YES" : "NO");

    ssd1306_write_cmd(0xAE); /* Display OFF */
    ssd1306_write_cmd(0x20); /* Set Memory Addressing Mode */
    ssd1306_write_cmd(0x02); /* Page Addressing Mode */
    ssd1306_write_cmd(0xB0);
    ssd1306_write_cmd(0xC8); /* COM Output Scan Direction */
    ssd1306_write_cmd(0x00);
    ssd1306_write_cmd(0x10);
    ssd1306_write_cmd(0x40);
    ssd1306_write_cmd(0x81); /* Contrast */
    ssd1306_write_cmd(0xFF);
    ssd1306_write_cmd(0xA1); /* Segment re-map */
    ssd1306_write_cmd(0xA6); /* Normal display */
    ssd1306_write_cmd(0xA8); /* Multiplex ratio */
    ssd1306_write_cmd(0x3F);
    ssd1306_write_cmd(0xA4);
    ssd1306_write_cmd(0xD3);
    ssd1306_write_cmd(0x00);
    ssd1306_write_cmd(0xD5);
    ssd1306_write_cmd(0xF0);
    ssd1306_write_cmd(0xD9);
    ssd1306_write_cmd(0x22);
    ssd1306_write_cmd(0xDA);
    ssd1306_write_cmd(0x12);
    ssd1306_write_cmd(0xDB);
    ssd1306_write_cmd(0x20);
    ssd1306_write_cmd(0x8D); /* Charge pump */
    ssd1306_write_cmd(0x14);
    ssd1306_write_cmd(0xAF); /* Display ON */

    Display_Clear();
}

void Display_Clear(void) {
    memset(ssd1306_buffer, 0x00, sizeof(ssd1306_buffer));
    ssd1306_update_screen();
}

void Display_SetPower(bool on) {
    ssd1306_write_cmd(on ? 0xAF : 0xAE);
}

void Display_RenderTemperature(float temperature) {
    char val_buf[24];
    snprintf(val_buf, sizeof(val_buf), "%.1f C", temperature);

    memset(ssd1306_buffer, 0x00, sizeof(ssd1306_buffer));
    ssd1306_draw_string(1, 20, "ROOM MONITOR");
    ssd1306_draw_string(3, 24, "Temperature");
    ssd1306_draw_string(5, 36, val_buf);
    ssd1306_update_screen();
}